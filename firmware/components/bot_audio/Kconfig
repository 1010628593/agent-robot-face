## firmware/components/bot_audio/Kconfig
```kconfig
menu "Bot audio interactions"
    config BOT_AUDIO_ENABLE
        bool "Enable optional microphone audio service"
        default n
        help
            Enable microphone audio processing for environmental sound response.
            When enabled, the bot can respond to environmental sounds with
            facial expressions. When disabled, no audio hardware is initialized.
            Default is n (disabled) per privacy-first design.

    config BOT_AUDIO_G0_VERIFIED
        bool "Board audio contract physically verified (release gate)"
        default n
        depends on BOT_AUDIO_ENABLE
        help
            Enable runtime microphone requests only after the board-specific
            G0 input, stop and resource report has passed. Compile success is
            not verification. Probe builds bypass this gate, never normal UI.

    config BOT_AUDIO_DIAGNOSTICS
        bool "Enable audio diagnostics logging"
        default n
        depends on BOT_AUDIO_ENABLE
        help
            Enable low-frequency diagnostic logging of audio processing.
            Logs include RMS levels, event counts, and service state.
            No PCM data is logged. Maximum 1 Hz log rate.

    config BOT_AUDIO_G0_PROBE
        bool "G0 audio contract probe (development verification only)"
        default n
        help
            Runs a bounded hardware contract probe at boot INSTEAD of the
            normal UI: verifies init/open/read timing/short reads/close and
            prints a "@g0 {...}" summary. Does not start LVGL or the IMU.
            Operator must keep quiet for phase A, then clap/talk for phase B.
            DEVELOPMENT ONLY - do not ship. Requires BOT_AUDIO_ENABLE.
        depends on BOT_AUDIO_ENABLE
endmenu
```

## firmware/components/bot_imu/Kconfig
```kconfig
menu "Bot motion interactions"
    config BOT_IMU_ENABLE
        bool "Enable optional QMI8658 motion service"
        default y
        help
            WHO_AM_I is verified before sensor-only writes. Missing sensor
            disables motion; it must not interrupt display or touch.
    config BOT_IMU_MOUNT_DEG
        int "Sensor gravity angle when face is physically upright (degrees)"
        range -180 180
        default 0
        help
            atan2(accel_x, -accel_y) in degrees, measured at rest with the
            screen upright. This board mounting value needs a local check;
            zero is a reference convention, NOT verified hardware alignment.
    config BOT_IMU_MOUNT_FINE_TENTHS
        int "Fine mounting correction (tenths of a degree)"
        range -9 9
        default 0
        help
            Added to BOT_IMU_MOUNT_DEG as tenths, for measured local alignment.
    config BOT_IMU_REVERSE_ROTATION
        bool "Reverse face compensation for opposite PCB/sensor normal"
        default n
        help
            Enable only if the mounting-axis check shows compensation moves
            in the same physical direction as the enclosure.
    config BOT_IMU_DIAGNOSTICS
        bool "Log six-axis samples and orientation at most once per second"
        default n
endmenu
```

## firmware/components/bot_ui/Kconfig
```kconfig
menu "Bot UI"
config BOT_DEV_SIM
    bool "Developer simulator (synthetic data on every page)"
    default n
    help
        Independent development build only. Production requires the USB Bridge.
endmenu
```
