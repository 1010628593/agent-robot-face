/*******************************************************************************
 * Size: 36 px
 * Bpp: 4
 * Opts: --font /tmp/bot-NotoSansSC-Regular.ttf --size 36 --bpp 4 --format lvgl --lv-include lvgl.h --range 0x25,0x2d-0x2e,0x30-0x39,0x42,0x4b,0x4d --symbols — --no-compress --no-prefilter --output firmware/components/bot_ui/assets/bot_usage_36.inc
 ******************************************************************************/

#ifdef LV_LVGL_H_INCLUDE_SIMPLE
#include "lvgl.h"
#else
#include "lvgl.h"
#endif

#ifndef BOT_USAGE_36
#define BOT_USAGE_36 1
#endif

#if BOT_USAGE_36

/*-----------------
 *    BITMAPS
 *----------------*/

/*Store the image of the glyphs*/
static LV_ATTRIBUTE_LARGE_CONST const uint8_t u36_glyph_bitmap[] = {
    /* U+0025 "%" */
    0x0, 0x4, 0xbe, 0xfe, 0xa2, 0x0, 0x0, 0x0,
    0x0, 0x0, 0x9, 0xfa, 0x0, 0x0, 0x0, 0x0,
    0x8, 0xff, 0xff, 0xff, 0xf5, 0x0, 0x0, 0x0,
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    0xfb, 0x40, 0x0,

    /* U+002D "-" */
    0x28, 0x88, 0x88, 0x88, 0x87, 0x5f, 0xff, 0xff,
    0xff, 0xfe, 0x5f, 0xff, 0xff, 0xff, 0xfe,

    /* U+002E "." */
    0x6, 0xee, 0x60, 0x2f, 0xff, 0xf2, 0x5f, 0xff,
    0xf5, 0x2f, 0xff, 0xf2, 0x6, 0xee, 0x60,

    /* U+0030 "0" */
    0x0, 0x0, 0x2, 0x9d, 0xff, 0xd9, 0x20, 0x0,
    0x0, 0x0, 0x0, 0x7f, 0xff, 0xff, 0xff, 0xf7,
    0x0, 0x0, 0x0, 0x7, 0xff, 0xfe, 0xaa, 0xef,
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    0x0, 0x0,

    /* U+0031 "1" */
    0x0, 0x0, 0x5, 0xdf, 0xf5, 0x0, 0x0, 0x0,
    0x26, 0xaf, 0xff, 0xff, 0x50, 0x0, 0x0, 0xa,
    0xff, 0xff, 0xff, 0xf5, 0x0, 0x0, 0x0, 0x9e,
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    0xff, 0xff, 0xfa,

    /* U+0032 "2" */
    0x0, 0x0, 0x4a, 0xdf, 0xfe, 0xb6, 0x0, 0x0,
    0x0, 0x0, 0x2b, 0xff, 0xff, 0xff, 0xff, 0xe4,
    0x0, 0x0, 0x4, 0xef, 0xff, 0xda, 0xbe, 0xff,
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    0xff, 0xf3,

    /* U+0033 "3" */
    0x0, 0x0, 0x39, 0xdf, 0xff, 0xd9, 0x30, 0x0,
    0x0, 0x2, 0xbf, 0xff, 0xff, 0xff, 0xff, 0xb1,
    0x0, 0x5, 0xff, 0xff, 0xdb, 0xac, 0xff, 0xff,
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    0xff, 0xfc, 0x93, 0x0, 0x0,

    /* U+0034 "4" */
    0x0, 0x0, 0x0, 0x0, 0x0, 0xa, 0xff, 0xf5,
    0x0, 0x0, 0x0, 0x0, 0x0, 0x0, 0x4, 0xff,
    0xff, 0x50, 0x0, 0x0, 0x0, 0x0, 0x0, 0x1,
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    0x0, 0x0, 0x0, 0xc, 0xff, 0x50, 0x0,

    /* U+0035 "5" */
    0x0, 0x1, 0xff, 0xff, 0xff, 0xff, 0xff, 0xff,
    0xc0, 0x0, 0x0, 0x2f, 0xff, 0xff, 0xff, 0xff,
    0xff, 0xfc, 0x0, 0x0, 0x3, 0xff, 0xfc, 0xcc,
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    0x6a, 0xdf, 0xfe, 0xb6, 0x0, 0x0, 0x0,

    /* U+0036 "6" */
    0x0, 0x0, 0x0, 0x6b, 0xef, 0xfd, 0x92, 0x0,
    0x0, 0x0, 0x5, 0xef, 0xff, 0xff, 0xff, 0xf8,
    0x0, 0x0, 0x7, 0xff, 0xff, 0xeb, 0xbe, 0xff,
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    0xef, 0xfc, 0x71, 0x0, 0x0,

    /* U+0037 "7" */
    0x3f, 0xff, 0xff, 0xff, 0xff, 0xff, 0xff, 0xff,
    0xf4, 0x3f, 0xff, 0xff, 0xff, 0xff, 0xff, 0xff,
    0xff, 0xf4, 0x3c, 0xcc, 0xcc, 0xcc, 0xcc, 0xcc,
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    0x0, 0x0,

    /* U+0038 "8" */
    0x0, 0x0, 0x3, 0x9d, 0xff, 0xeb, 0x60, 0x0,
    0x0, 0x0, 0x0, 0x9f, 0xff, 0xff, 0xff, 0xfd,
    0x20, 0x0, 0x0, 0xb, 0xff, 0xfb, 0x77, 0xaf,
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    0x0, 0x0,

    /* U+0039 "9" */
    0x0, 0x0, 0x18, 0xdf, 0xfe, 0xa5, 0x0, 0x0,
    0x0, 0x0, 0x6, 0xff, 0xff, 0xff, 0xff, 0xc2,
    0x0, 0x0, 0x0, 0x7f, 0xff, 0xe9, 0x9b, 0xff,
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    0x0, 0x0,

    /* U+0042 "B" */
    0x5f, 0xff, 0xff, 0xff, 0xff, 0xeb, 0x83, 0x0,
    0x0, 0x0, 0x5f, 0xff, 0xff, 0xff, 0xff, 0xff,
    0xff, 0xc3, 0x0, 0x0, 0x5f, 0xff, 0xaa, 0xaa,
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    0xa6, 0x10, 0x0, 0x0,

    /* U+004B "K" */
    0x5f, 0xff, 0x0, 0x0, 0x0, 0x0, 0x0, 0x5f,
    0xff, 0x60, 0x5, 0xff, 0xf0, 0x0, 0x0, 0x0,
    0x0, 0x3f, 0xff, 0x90, 0x0, 0x5f, 0xff, 0x0,
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    0xc0,

    /* U+004D "M" */
    0x5f, 0xff, 0xc0, 0x0, 0x0, 0x0, 0x0, 0x0,
    0x0, 0x9f, 0xff, 0x95, 0xff, 0xff, 0x20, 0x0,
    0x0, 0x0, 0x0, 0x0, 0xe, 0xff, 0xf9, 0x5f,
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    0x0, 0x8f, 0xf9,

    /* U+2014 "—" */
    0x13, 0x33, 0x33, 0x33, 0x33, 0x33, 0x33, 0x33,
    0x33, 0x33, 0x33, 0x33, 0x33, 0x33, 0x31, 0x5f,
    0xff, 0xff, 0xff, 0xff, 0xff, 0xff, 0xff, 0xff,
    0xff, 0xff, 0xff, 0xff, 0xff, 0xf7, 0x5f, 0xff,
    0xff, 0xff, 0xff, 0xff, 0xff, 0xff, 0xff, 0xff,
    0xff, 0xff, 0xff, 0xff, 0xf7
};


/*---------------------
 *  GLYPH DESCRIPTION
 *--------------------*/

static const lv_font_fmt_txt_glyph_dsc_t u36_glyph_dsc[] = {
    {.bitmap_index = 0, .adv_w = 0, .box_w = 0, .box_h = 0, .ofs_x = 0, .ofs_y = 0} /* id = 0 reserved */,
    {.bitmap_index = 0, .adv_w = 530, .box_w = 31, .box_h = 26, .ofs_x = 1, .ofs_y = 0},
    {.bitmap_index = 403, .adv_w = 200, .box_w = 10, .box_h = 3, .ofs_x = 1, .ofs_y = 9},
    {.bitmap_index = 418, .adv_w = 160, .box_w = 6, .box_h = 5, .ofs_x = 2, .ofs_y = 0},
    {.bitmap_index = 433, .adv_w = 320, .box_w = 18, .box_h = 26, .ofs_x = 1, .ofs_y = 0},
    {.bitmap_index = 667, .adv_w = 320, .box_w = 15, .box_h = 26, .ofs_x = 3, .ofs_y = 0},
    {.bitmap_index = 862, .adv_w = 320, .box_w = 18, .box_h = 26, .ofs_x = 1, .ofs_y = 0},
    {.bitmap_index = 1096, .adv_w = 320, .box_w = 17, .box_h = 26, .ofs_x = 1, .ofs_y = 0},
    {.bitmap_index = 1317, .adv_w = 320, .box_w = 19, .box_h = 26, .ofs_x = 0, .ofs_y = 0},
    {.bitmap_index = 1564, .adv_w = 320, .box_w = 19, .box_h = 26, .ofs_x = 0, .ofs_y = 0},
    {.bitmap_index = 1811, .adv_w = 320, .box_w = 17, .box_h = 26, .ofs_x = 2, .ofs_y = 0},
    {.bitmap_index = 2032, .adv_w = 320, .box_w = 18, .box_h = 26, .ofs_x = 1, .ofs_y = 0},
    {.bitmap_index = 2266, .adv_w = 320, .box_w = 18, .box_h = 26, .ofs_x = 1, .ofs_y = 0},
    {.bitmap_index = 2500, .adv_w = 320, .box_w = 18, .box_h = 26, .ofs_x = 1, .ofs_y = 0},
    {.bitmap_index = 2734, .adv_w = 378, .box_w = 20, .box_h = 26, .ofs_x = 3, .ofs_y = 0},
    {.bitmap_index = 2994, .adv_w = 372, .box_w = 21, .box_h = 26, .ofs_x = 3, .ofs_y = 0},
    {.bitmap_index = 3267, .adv_w = 468, .box_w = 23, .box_h = 26, .ofs_x = 3, .ofs_y = 0},
    {.bitmap_index = 3566, .adv_w = 515, .box_w = 30, .box_h = 3, .ofs_x = 1, .ofs_y = 9}
};

/*---------------------
 *  CHARACTER MAPPING
 *--------------------*/

static const uint16_t u36_unicode_list_0[] = {
    0x0, 0x8, 0x9, 0xb, 0xc, 0xd, 0xe, 0xf,
    0x10, 0x11, 0x12, 0x13, 0x14, 0x1d, 0x26, 0x28,
    0x1fef
};

/*Collect the unicode lists and glyph_id offsets*/
static const lv_font_fmt_txt_cmap_t u36_cmaps[] =
{
    {
        .range_start = 37, .range_length = 8176, .glyph_id_start = 1,
        .unicode_list = u36_unicode_list_0, .glyph_id_ofs_list = NULL, .list_length = 17, .type = LV_FONT_FMT_TXT_CMAP_SPARSE_TINY
    }
};

/*-----------------
 *    KERNING
 *----------------*/


/*Pair left and right glyphs for kerning*/
static const uint8_t u36_kern_pair_glyph_ids[] =
{
    15, 2,
    15, 17
};

/* Kerning between the respective left and right glyphs
 * 4.4 format which needs to scaled with `kern_scale`*/
static const int8_t u36_kern_pair_values[] =
{
    -20, -20
};

/*Collect the kern pair's data in one place*/
static const lv_font_fmt_txt_kern_pair_t u36_kern_pairs =
{
    .glyph_ids = u36_kern_pair_glyph_ids,
    .values = u36_kern_pair_values,
    .pair_cnt = 2,
    .glyph_ids_size = 0
};

/*--------------------
 *  ALL CUSTOM DATA
 *--------------------*/

#if LVGL_VERSION_MAJOR == 8
/*Store all the custom data of the font*/
static  lv_font_fmt_txt_glyph_cache_t cache;
#endif

#if LVGL_VERSION_MAJOR >= 8
static const lv_font_fmt_txt_dsc_t u36_font_dsc = {
#else
static lv_font_fmt_txt_dsc_t u36_font_dsc = {
#endif
    .glyph_bitmap = u36_glyph_bitmap,
    .glyph_dsc = u36_glyph_dsc,
    .cmaps = u36_cmaps,
    .kern_dsc = &u36_kern_pairs,
    .kern_scale = 16,
    .cmap_num = 1,
    .bpp = 4,
    .kern_classes = 0,
    .bitmap_format = 0,
#if LVGL_VERSION_MAJOR == 8
    .cache = &cache
#endif
};



/*-----------------
 *  PUBLIC FONT
 *----------------*/

/*Initialize a public general font descriptor*/
#if LVGL_VERSION_MAJOR >= 8
const lv_font_t bot_usage_36 = {
#else
lv_font_t bot_usage_36 = {
#endif
    .get_glyph_dsc = lv_font_get_glyph_dsc_fmt_txt,    /*Function pointer to get glyph's data*/
    .get_glyph_bitmap = lv_font_get_bitmap_fmt_txt,    /*Function pointer to get glyph's bitmap*/
    .line_height = 26,          /*The maximum line height required by the font*/
    .base_line = 0,             /*Baseline measured from the bottom of the line*/
#if !(LVGL_VERSION_MAJOR == 6 && LVGL_VERSION_MINOR == 0)
    .subpx = LV_FONT_SUBPX_NONE,
#endif
#if LV_VERSION_CHECK(7, 4, 0) || LVGL_VERSION_MAJOR >= 8
    .underline_position = -4,
    .underline_thickness = 2,
#endif
    .dsc = &u36_font_dsc,          /*The custom font data. Will be accessed by `get_glyph_bitmap/dsc` */
#if LV_VERSION_CHECK(8, 2, 0) || LVGL_VERSION_MAJOR >= 9
    .fallback = NULL,
#endif
    .user_data = NULL,
};



#endif /*#if BOT_USAGE_36*/

